## src/Kconfig
```kconfig
menu "LoongArch-core configuration menu"

choice
  prompt "Simulation backend"
  default BSIM

config BSIM
  bool "Enable BSC Connectal/Bluesim simulation"

config VSIM
  bool "Enable Verilog simulation/top-level debug ports"

config FPGA
  bool "Enable FPGA top-level without instruction debug ports"

endchoice

menu "TRACE_WAVE switch"
  depends on BSIM
  config TRACE_WAVE
    bool "Enable trace wave"
    default n
  config WAVE_PC_START
    hex "wave pc start"
    default 0x30000000
  config WAVE_PC_END
    hex "wave pc end"
    default 0x30000000
endmenu

  config DIFFTEST
    bool "Enable difftest"
    depends on BSIM || VSIM
    default n

  config TRACE_PERFORMANCE
    bool "Enable performance tracer"
    depends on BSIM
    default y

  config MTRACE
    bool "Enable memery trace"
    depends on BSIM
    default n
endmenu

menu "TLB Config"
config TLB_ENTRIES
    hex "Number of TLB entries (power of 2)"
    default 0x20
endmenu

menu "Cache Config"

menu "DCACHE"
config DCACHE_SETS
    hex "SETS"
    default 0x100

config DCACHE_WAYS
    hex "ASSOCIATIVITYS"
    default 0x2

config DCACHE_LINE_WORDS
    hex "BLOCKS"
    default 0x4
endmenu

menu "ICACHE"
config ICACHE_SETS
    hex "SETS"
    default 0x100

config ICACHE_WAYS
    hex "ASSOCIATIVITYS"
    default 0x2

config ICACHE_LINE_WORDS
    hex "BLOCKS"
    default 0x4

endmenu

endmenu

menu "Branch Prediction Config"

config SMALL_BTB_ENTRIES
    hex "Small BTB entries (power of 2)"
    default 0x20
    help
      Number of entries in the fast-path Small BTB (L0 predictor).
      Must be a power of 2. Common values: 0x10 (16), 0x20 (32), 0x40 (64).
      SmallBtb stays flip-flop based (P0 path needs combinational read).

config MBTB_ENTRIES
    hex "Main BTB entries (power of 2)"
    default 0x80
    help
      Number of entries in the L1 accurate-path Main BTB.
      Must be a power of 2. Default 0x80 (128) matches the sram_128x64_wrap
      depth used when CONFIG_FPGA is set. On FPGA the value must be <= 128.

config TAGE_ENTRIES
    hex "TAGE tagged table entries per table (power of 2)"
    default 0x40
    help
      Number of entries per TAGE tagged table (T1-T7).
      Must be a power of 2. Default 0x40 (64). On FPGA the value must be
      <= 128 (sram_128x64_wrap depth); the lower half is used.

config ITTAGE_ENTRIES
    hex "ITTAGE tagged table entries per table (power of 2)"
    default 0x40
    help
      Number of entries per ITTAGE tagged table (T1-T4).
      Must be a power of 2. Default 0x40 (64). On FPGA the value must be
      <= 128 (sram_128x64_wrap depth); the lower half is used.

endmenu
```
